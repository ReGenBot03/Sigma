## boards/shields/sigma/Kconfig.defconfig
```kconfig
if SHIELD_SIGMA_LEFT

config ZMK_KEYBOARD_NAME
	default "Sigma"

config ZMK_SPLIT_ROLE_CENTRAL
	default y

endif

if SHIELD_SIGMA_LEFT || SHIELD_SIGMA_RIGHT

config ZMK_SPLIT
	default y

endif
```

## boards/shields/sigma/Kconfig.shield
```kconfig
config SHIELD_SIGMA_LEFT
    def_bool $(shields_list_contains,sigma_left)

config SHIELD_SIGMA_RIGHT
    def_bool $(shields_list_contains,sigma_right)
```
